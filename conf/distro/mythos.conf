## conf/distro/mythos.conf
```bitbake
# Started with poky-lsb, which subclasses poky.

require conf/distro/poky.conf
include conf/distro/include/security_flags.conf

DISTRO = "mythos"
DISTRO_NAME = "MythOS RT Linux for Aeon Spacecraft"
DISTRO_CODENAME = "Release2a"

MAINTAINER = "David Smyth <David.Smyth@Millennium-Space.com>"
TARGET_VENDOR = "-mythos"

DISTROOVERRIDES = "poky:linuxstdbase"

VIRTUAL-RUNTIME_init_manager = "systemd"

DISTRO_FEATURES_append = "\
    uboot \
    systemd \
    multiarch \
    ipv6 \
    nfs \
    pci \
    pcmcia \
    ruby \
    cherokee \
    nginx \
    ssh-server-openssh \
    nfs-server \
    hwcodecs \
    package-management \
    largefile \
    ptest \
    x11 \
    qt3 \
    pam largefile opengl"

#DISTRO_FEATURES_append = " pam largefile opengl"
#PREFERRED_PROVIDER_virtual/libx11 = "libx11"

# Ensure the kernel nfs server is enabled
KERNEL_FEATURES_append_pn-linux-mythos = " features/nfsd/nfsd-enable.scc"
```
